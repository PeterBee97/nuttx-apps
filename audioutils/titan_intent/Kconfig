## audioutils/titan_voicefe/Kconfig
```kconfig
# For a description of the syntax of this configuration file,
# see the file kconfig-language.txt in the NuttX tools repository.

config AUDIOUTILS_TITAN_VOICEFE
	bool "Fixed-point stereo voice front end"
	default n
	help
		DC blocking, Q15 gain, bounded delay-and-sum and energy VAD.
		No allocation or OS services are used by these primitives.

if AUDIOUTILS_TITAN_VOICEFE

config AUDIOUTILS_TITAN_VOICEFE_NS
	bool "Fixed-point spectral noise suppression"
	default n
	help
		20 ms sine-windowed spectral gain with 10 ms overlap and
		adapting noise estimates. Requires about 8 KiB static state.

config AUDIOUTILS_TITAN_VOICEFE_NS_FLOOR
	int "Minimum spectral amplitude gain (Q15)"
	default 8192
	range 4096 16384
	depends on AUDIOUTILS_TITAN_VOICEFE_NS
	help
		8192 limits suppression to approximately 12 dB. Higher values
		retain more background and reduce weak-speech attenuation.

config AUDIOUTILS_TITAN_VOICEFE_FEATURES
	bool "Fixed-point log Mel features"
	default n
	help
		400 sample Hann window, 320 sample hop, shared 512 point FFT
		and 40 Mel bands for 16 kHz local speech classification.
		State uses about 6.2 KiB; tables and buffers are excluded
		when this option is disabled.

endif
```

## mlearning/tflite-micro/Kconfig
```kconfig
#
# For a description of the syntax of this configuration file,
# see the file kconfig-language.txt in the NuttX tools repository.
#

config TFLITEMICRO
	bool "TFLiteMicro"
	default n
	depends on SYSTEM_FLATBUFFERS && MATH_GEMMLOWP && MATH_KISSFFT && MATH_RUY

if TFLITEMICRO
config TFLITEMICRO_DEBUG
	bool "Print tflite-micro's debug message"
	default n

config TFLITEMICRO_TOOL
	bool "tflite-micro cmdline tool"
	default n

config TFLITEMICRO_SYSLOG
	bool "tflite-micro syslog backend"
	default n

if TFLITEMICRO_SYSLOG

config TFLITEMICRO_SYSLOG_LEVEL
	int "tflite-micro syslog level"
	default 6
	---help---
		Syslog level mapping of tflm, This log level mapping is consistent
		with the nuttx syslog level, please refer to syslog.h:

		define LOG_EMERG     0  /* System is unusable */
		define LOG_ALERT     1  /* Action must be taken immediately */
		define LOG_CRIT      2  /* Critical conditions */
		define LOG_ERR       3  /* Error conditions */
		define LOG_WARNING   4  /* Warning conditions */
		define LOG_NOTICE    5  /* Normal, but significant, condition */
		define LOG_INFO      6  /* Informational message */
		define LOG_DEBUG     7  /* Debug-level message */

endif # TFLITEMICRO_SYSLOG

if TFLITEMICRO_TOOL
config TFLITEMICRO_TOOL_PRIORITY
	int "tflite-micro tool priority"
	default 100

config TFLITEMICRO_TOOL_STACKSIZE
	int "tflite-micro tool stacksize"
	default 4096

endif # TFLITEMICRO_TOOL

config TFLITEMICRO_HELLOWORLD
	bool "Enable Tflite-micro hello world example"
	default n

if TFLITEMICRO_HELLOWORLD
config TFLITEMICRO_HELLOWORLD_PRIORITY
	int "Tflite-micro hello world priority"
	default 100

config TFLITEMICRO_HELLOWORLD_STACKSIZE
	int "Tflite-micro hello world stacksize"
	default 4096

endif # TFLITEMICRO_HELLOWORLD

config TFLITEMICRO_ETHOSU
	bool "Arm Ethos-U custom operator"
	default n
	depends on AI_ENGINE_ETHOSU
	help
		Build the TFLite Micro Ethos-U custom operator and connect it to a
		NuttX Ethos-U AI engine character device.

if TFLITEMICRO_ETHOSU

config TFLITEMICRO_ETHOSU_DEVPATH
	string "Ethos-U device path"
	default "/dev/ethosu0"

endif # TFLITEMICRO_ETHOSU

config TFLITEMICRO_ETHOSU_VWW
	bool "Ethos-U55 VWW96 inference example"
	default n
	depends on TFLITEMICRO_ETHOSU
	help
		Embed an Apache-2.0 Vela-compiled visual wake-word model and add
		the tflm_ethosu_vww command.  It runs one zero-input inference
		and reports output values, elapsed time and NPU PMU cycles.

if TFLITEMICRO_ETHOSU_VWW

config TFLITEMICRO_ETHOSU_VWW_PRIORITY
	int "Ethos-U55 example priority"
	default 100

config TFLITEMICRO_ETHOSU_VWW_STACKSIZE
	int "Ethos-U55 example stack size"
	default 8192

config TFLITEMICRO_ETHOSU_VWW_ARENA_SIZE
	int "Ethos-U55 example tensor arena size"
	default 131072
	range 98304 262144

endif # TFLITEMICRO_ETHOSU_VWW

config TFLITEMICRO_TITAN_INTENT
	bool "Titan U55 local speech models"
	default n
	depends on TFLITEMICRO_ETHOSU
	select AUDIOUTILS_TITAN_INTENT
	select AUDIOUTILS_TITAN_VOICEFE
	select AUDIOUTILS_TITAN_VOICEFE_FEATURES
	help
		Embed two INT8 Vela models and static NPU-visible tensor arenas.
		The model pair and quantization metadata must match the shared
		fixed-point feature extractor.

if TFLITEMICRO_TITAN_INTENT

config TFLITEMICRO_TITAN_INTENT_WAKE_ARENA
	int "Wake tensor arena bytes"
	default 32768
	range 16384 32768

config TFLITEMICRO_TITAN_INTENT_COMMAND_ARENA
	int "Command tensor arena bytes"
	default 65536
	range 24576 65536

config TFLITEMICRO_TITAN_INTENT_ONLY
	bool "Build only operators used by Titan intent"
	default y
	depends on !TFLITEMICRO_TOOL && !TFLITEMICRO_HELLOWORLD
	depends on !TFLITEMICRO_ETHOSU_VWW && !MLEARNING_CMSIS_NN
	help
		Exclude unrelated CPU inference kernels. The model pair uses
		Ethos-U and optionally a static reshape at its boundary.

endif # TFLITEMICRO_TITAN_INTENT
endif # TFLITEMICRO
```

## system/titan_voice/Kconfig
```kconfig
# For a description of the syntax of this configuration file,
# see the file kconfig-language.txt in the NuttX tools repository.

menuconfig SYSTEM_TITAN_VOICE
	bool "Titan Mini voice front end"
	default n
	depends on TITAN_MINI_PDM && !BUILD_KERNEL
	select AUDIOUTILS_TITAN_VOICEFE
	help
		Start explicitly with voicefe. Capture and network use separate
		workers and static PCM queues.

if SYSTEM_TITAN_VOICE

config SYSTEM_TITAN_VOICE_ASR_HTTP
	bool "Chunked HTTP ASR upload"
	default y if NET_TCP && NET_IPv4
	depends on NET_TCP && NET_IPv4

config SYSTEM_TITAN_VOICE_INTENT
	bool "Local U55 wake and finite commands"
	default n
	depends on TFLITEMICRO_TITAN_INTENT
	select SYSTEM_TITAN_VOICE_VAD

if SYSTEM_TITAN_VOICE_INTENT

config SYSTEM_TITAN_VOICE_INTENT_TELEMETRY
	bool "Send local events and state to the TUI backend"
	default n
	depends on NET_TCP && NET_IPv4

config SYSTEM_TITAN_VOICE_INTENT_DEVICE
	string "Device event identifier"
	default "titan-mini"

config SYSTEM_TITAN_VOICE_INTENT_STACKSIZE
	int "Local ML worker stack bytes"
	default 8192
	range 4096 16384

config SYSTEM_TITAN_VOICE_INTENT_PRIORITY
	int "Local ML worker priority"
	default 110

config SYSTEM_TITAN_VOICE_INTENT_QUEUE
	int "Local ML PCM queue blocks"
	default 20
	range 10 20

config SYSTEM_TITAN_VOICE_INTENT_WINDOW_MS
	int "Double wake next utterance window (ms)"
	default 8000
	range 1000 8000

config SYSTEM_TITAN_VOICE_INTENT_COOLDOWN_MS
	int "Same action cooldown (ms)"
	default 1000
	range 0 5000

config SYSTEM_TITAN_VOICE_INTENT_END_MS
	int "Local command silence endpoint (ms)"
	default 250
	range 250 250

config SYSTEM_TITAN_VOICE_INTENT_MAX_MS
	int "Maximum command speech span (ms)"
	default 4000
	range 4000 4000

config SYSTEM_TITAN_VOICE_INTENT_WAKE_SCORE
	int "Wake posterior Q15 (-1 uses model metadata)"
	default -1
	range -1 32768

config SYSTEM_TITAN_VOICE_INTENT_WAKE_MARGIN
	int "Wake posterior margin Q15 (-1 uses metadata)"
	default -1
	range -1 32768

config SYSTEM_TITAN_VOICE_INTENT_COMMAND_SCORE
	int "Command posterior Q15 (-1 uses metadata)"
	default -1
	range -1 32768

config SYSTEM_TITAN_VOICE_INTENT_COMMAND_MARGIN
	int "Command posterior margin Q15 (-1 uses metadata)"
	default -1
	range -1 32768

endif

config SYSTEM_TITAN_VOICE_BF
	bool "Allow delay-and-sum mode"
	default y

config SYSTEM_TITAN_VOICE_VAD
	bool "Energy VAD"
	default y

config SYSTEM_TITAN_VOICE_NS
	bool "Enable spectral noise suppression"
	default n
	select AUDIOUTILS_TITAN_VOICEFE_NS
	help
		Process mono PCM before upload. VAD uses the unprocessed signal
		to avoid losing quiet speech. Disable at runtime with -n 0.

config SYSTEM_TITAN_VOICE_DEBUG_CAPTURE
	bool "Capture diagnostics command"
	default y

config SYSTEM_TITAN_VOICE_PROFILE
	bool "Measure DSP and enqueue cycles"
	default n
	depends on ARCH_HAVE_PERF_EVENTS
	select ARCH_PERF_EVENTS

config SYSTEM_TITAN_VOICE_STACKSIZE
	int "Capture worker stack"
	default 4096

config SYSTEM_TITAN_VOICE_NET_STACKSIZE
	int "Upload worker stack"
	default 6144

config SYSTEM_TITAN_VOICE_PRIORITY
	int "Capture priority"
	default 120

config SYSTEM_TITAN_VOICE_NET_PRIORITY
	int "Upload priority"
	default 100

config SYSTEM_TITAN_VOICE_BLOCK_MS
	int "DSP block duration (ms)"
	default 10
	range 10 10

config SYSTEM_TITAN_VOICE_PREROLL_MS
	int "Pre-roll (ms)"
	default 300
	range 30 500

config SYSTEM_TITAN_VOICE_HANGOVER_MS
	int "VAD hangover (ms)"
	default 800
	range 100 2000

config SYSTEM_TITAN_VOICE_MAX_UTTERANCE_MS
	int "Maximum utterance (ms)"
	default 20000
	range 1000 20000

config SYSTEM_TITAN_VOICE_HOST
	string "ASR IPv4 address"
	default "192.168.77.1"

config SYSTEM_TITAN_VOICE_PORT
	int "ASR port"
	default 8008
	range 1 65535

config SYSTEM_TITAN_VOICE_LEFT_GAIN
	int "Persisted left Q15 gain"
	default 32768
	range 4096 65536

config SYSTEM_TITAN_VOICE_RIGHT_GAIN
	int "Persisted right Q15 gain"
	default 32768
	range 4096 65536

endif
```
